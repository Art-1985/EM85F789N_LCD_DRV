;------------------------------------------------------------------------------
; EM85F789N.INC
;------------------------------------------------------------------------------
; Target:         EM85F789N
; Tool chain:     Keil
; Command Line:   None
;
; Release 1.0
;    -Initial Revision
;    -21 DEC 2017
;

;------------------------------------------------------------------------------
; Byte Registers
;------------------------------------------------------------------------------
;; SFR PAGE 0
P0			DATA	080H
SP			DATA	081H
DPL			DATA	082H
DPH			DATA	083H
DPL1		DATA	084H
DPH1		DATA	085H
PAGESW		DATA	086H
PCON		DATA	087H
TCON		DATA	088H
TMOD		DATA	089H
TL0			DATA	08AH
TL1			DATA	08BH
TH0			DATA	08CH
TH1			DATA	08DH
CKCON0		DATA	08EH
CKCON1		DATA	08FH

P1			DATA	090H
ADCR1		DATA	091H
ADCR2		DATA	092H
ADISR		DATA	093H
ADER1		DATA	094H
ADER2		DATA	095H
ADDL		DATA	096H
ADDH		DATA	097H
SCON0		DATA	098H
SBUF0		DATA	099H
ADCVL		DATA	09AH
ADCVH		DATA	09BH
ADER3		DATA	09CH
ADER4		DATA	09DH
HLVDCR		DATA	09EH
HLVDCR1		DATA	09FH
P2		DATA	0A0H
; Reserved
IE		DATA	0A8H
XPAGE		DATA	0A9H
; Reserved
SPIRDAFBC	DATA	0ACH
; Reserved
PRST		DATA	0AEH
; Reserved
P3		DATA	0B0H
EIE1		DATA	0B1H
EIE2		DATA	0B2H
EIE3		DATA	0B3H
; Reserved
EIESC1		DATA	0B6H
; Reserved
IP		DATA	0B8H
EIP1		DATA	0B9H
EIP2		DATA	0BAH
EIP3		DATA	0BBH
; Reserved
SPICON1		DATA	0BDH
SPICON2		DATA	0BEH
SPISR1		DATA	0BFH
RSTSC		DATA	0C0H
SPISR2		DATA	0C1H
SPITDBR		DATA	0C2H
SPIRDBR		DATA	0C3H
SPITDBC		DATA	0C4H
SPIRDBC		DATA	0C5H
SPIBUFPTR1	DATA	0C6H
SPIBUFPTR2	DATA	0C7H
; Reserved
FLKEY		DATA	0C9H
FLCR		DATA	0CAH
EPKEY		DATA	0CBH
EPPOINTL	DATA	0CCH
EPPOINTH	DATA	0CDH
WDTKEY		DATA	0CEH
WDTCR		DATA	0CFH
PSW		DATA	0D0H
TC3CR1		DATA	0D1H
TC3CR2		DATA	0D2H
TC3DAL		DATA	0D3H
TC3DAH		DATA	0D4H
TC3DBL		DATA	0D5H
TC3DBH		DATA	0D6H
TC3CR3		DATA	0D7H
PSW1		DATA	0D8H
TC4CR1		DATA	0D9H
TC4CR2		DATA	0DAH
TC4DAL		DATA	0DBH
TC4DAH		DATA	0DCH
TC4DBL		DATA	0DDH
TC4DBH		DATA	0DEH
TC4CR3		DATA	0DFH
ACC		DATA	0E0H
; Reserved
BGREF0		DATA	0E3H
; Reserved
SDPWMCR1	DATA	0E6H
CMPNRCR1	DATA	0E7H
P4		DATA	0E8H
ICEN		DATA	0E9H
QBODICE		DATA	0EAH
CMP2CR2		DATA	0EBH
CMP2CR1		DATA	0ECH
OPCMP1CR2	DATA	0EDH
OPCMP1CR1	DATA	0EEH
COSF1		DATA	0EFH
B		DATA	0F0H
P0M0		DATA	0F1H
P0M1		DATA	0F2H
P1M0		DATA	0F3H
P1M1		DATA	0F4H
PHCON0		DATA	0F5H
PLCON0		DATA	0F6H
PHDSC0		DATA	0F7H
P5		DATA	0F8H
P2M0		DATA	0F9H
P2M1		DATA	0FAH
P3M0		DATA	0FBH
P3M1		DATA	0FCH
PHCON1		DATA	0FDH
PLCON1		DATA	0FEH
PHDSC1		DATA	0FFH

;; SFR PAGE 1
RTCCON		DATA	091H
RTCDATAH	DATA	092H
RTCDATAL	DATA	093H
ALARM		DATA	094H
RTCCAL1		DATA	095H
RTCCAL2		DATA	096H
RTCKEY		DATA	097H
;--
CO1TRL		DATA	09AH
; Reserved
CO2TRL		DATA	09CH
CO2TRH		DATA	09DH
; Reserved
LCDADDR		DATA	0A1H
LCDDATA		DATA	0A2H
; Reserved
LEDFR		DATA	0A4H
; Reserved
LCDCR1		DATA	0A9H
LCDCR2		DATA	0AAH
LCDCR3		DATA	0ABH
; Reserved
DEVPD1   	DATA	0ADH
DEVPD2   	DATA	0AEH
DEVPD3		DATA	0AFH
I2CCR1		DATA	0B1H
I2CCR2		DATA	0B2H
I2CSA		DATA	0B3H
I2CDB		DATA	0B4H
I2CDAL		DATA	0B5H
I2CDAH		DATA	0B6H
I2CSF		DATA	0B7H
I2CRXAF		DATA	0B9H
I2CTO1		DATA	0BAH
I2CTO1R		DATA	0BBH
I2CTO2		DATA	0BCH
I2CTO2R		DATA	0BDH
I2CTO3		DATA	0BEH
I2CTO3R		DATA	0BFH	
I2CTXLEN	DATA	0C1H
I2CRXLEN	DATA	0C2H
I2CSTASU	DATA	0C3H
I2CSTAHD	DATA	0C4H
I2CSCLFIR	DATA	0C5H
I2CSDAFIR	DATA	0C6H
I2CCR4		DATA	0C7H
DEADTR		DATA	0C9H
PWMENCR		DATA	0CAH
PWMACR2		DATA	0CBH
PWMBCR2		DATA	0CCH
PWMCCR2		DATA	0CDH
; Reserved
PWMACR1		DATA	0D1H
PRDAL		DATA	0D2H	
PRDAH		DATA	0D3H
DTAL		DATA	0D4H
DTAH		DATA	0D5H
TMRAL		DATA	0D6H
TMRAH		DATA	0D7H
PWMBCR1		DATA	0D9H
PRDBL		DATA	0DAH
PRDBH		DATA	0DBH
DTBL		DATA	0DCH
DTBH		DATA	0DDH
TMRBL		DATA	0DEH
TMRBH		DATA	0DFH
PWMCCR1		DATA	0E9H
PRDCL		DATA	0EAH
PRDCH		DATA	0EBH
DTCL		DATA	0ECH
DTCH		DATA	0EDH	
TMRCL		DATA	0EEH
TMRCH		DATA	0EFH
; Reserved
P4M0		DATA	0F1H
P4M1		DATA	0F2H
P5M0		DATA	0F3H
P5M1		DATA	0F4H
PHCON2		DATA	0F5H
PLCON2		DATA	0F6H
PHDSC2		DATA	0F7H
; Reserved

;; SFR PAGE 2
; Reserved
PLL1CR		DATA	0A1H
; Reserved
ARITH 		DATA	0A9H
MA0			DATA	0AAH
MA1			DATA	0ABH
MA2			DATA	0ACH
MA3			DATA	0ADH
MB0			DATA	0AEH
MB1			DATA	0AFH
EIOUART2	DATA	0B1H
EIOI2C0		DATA	0B2H
EIOSPI0		DATA	0B3H
EIOSPI1		DATA	0B4H
EXEN0		DATA	0B5H
EXEN1		DATA	0B6H
; Reserved
EXSF2		DATA	0B9H
EXSF3		DATA	0BAH
EXSF4		DATA	0BBH
; Reserved
EIES2		DATA	0BDH
EIES3		DATA	0BEH
EIES4		DATA	0BFH
EIOCOM1		DATA	0C1H
EIOSEG1		DATA	0C2H
EIOSEG2		DATA	0C3H
EIOSEG3		DATA	0C4H
EIOSEG4		DATA	0C5H
EIOSEG11	DATA	0C6H
; Reserved
EIOPWMA		DATA	0C9H
EIOPWMB		DATA	0CAH
EIOPWMC		DATA	0CBH
; Reserved
EIOT3		DATA	0CDH
EIOT4		DATA	0CEH
; Reserved
UR2BUFTXSF	DATA	0E9H
UR2BUFRXSF	DATA	0EAH
UR2BUFTXIM	DATA	0EBH
UR2BUFRXIM	DATA	0ECH
UR2TXLEN	DATA	0EDH
UR2RXLEN	DATA	0EEH
; Reserved
UR2CR		DATA	0F1H
UR2S		DATA	0F2H
UR2TD		DATA	0F3H
UR2RDL		DATA	0F4H
UR2RDH		DATA	0F5H
UR2S2		DATA	0F6H
UR2BRS		DATA	0F7H
LIRCTR		DATA	0FBH
; Reserved


;------------------------------------------------------------------------------
; Bit Registers
;------------------------------------------------------------------------------
; ALL PAGES
P00			BIT 	P0.0
P01			BIT 	P0.1
P02			BIT 	P0.2
P03			BIT 	P0.3
P04			BIT 	P0.4
P05			BIT 	P0.5
P06			BIT 	P0.6
P07			BIT 	P0.7

P10			BIT 	P1.0
P11			BIT 	P1.1
P12			BIT 	P1.2
P13			BIT 	P1.3
P14			BIT 	P1.4
P15			BIT 	P1.5
P16			BIT 	P1.6
P17			BIT 	P1.7

P20			BIT 	P2.0
P21			BIT 	P2.1
P22			BIT 	P2.2
P23			BIT 	P2.3
P24			BIT 	P2.4
P25			BIT 	P2.5
P26			BIT 	P2.6
P27			BIT 	P2.7

P30			BIT 	P3.0
P31			BIT 	P3.1
P32			BIT 	P3.2
P33			BIT 	P3.3
P34			BIT 	P3.4
P35			BIT 	P3.5
P36			BIT 	P3.6
P37			BIT 	P3.7

P40			BIT 	P4.0
P41			BIT 	P4.1
P42			BIT 	P4.2
P43			BIT 	P4.3
P44			BIT 	P4.4
P45			BIT 	P4.5
P46			BIT 	P4.6
P47			BIT 	P4.7

P50			BIT 	P5.0
P51			BIT 	P5.1
P52			BIT 	P5.2
P53			BIT 	P5.3
P54			BIT 	P5.4
P55			BIT 	P5.5
P56			BIT 	P5.6
P57			BIT 	P5.7

SHSF			BIT     PSW1.0

CY  			BIT     PSW.7
AC  			BIT     PSW.6
F0  			BIT     PSW.5
RS1  			BIT     PSW.4
RS0  			BIT     PSW.3
OV  			BIT     PSW.2
F1  			BIT     PSW.1
PARITY  		BIT     PSW.0

TF1			BIT     TCON.7
TR1			BIT     TCON.6
TF0			BIT     TCON.5
TR0			BIT     TCON.4
IE1			BIT     TCON.3
IT1			BIT     TCON.2
IE0			BIT     TCON.1
IT0			BIT     TCON.0

EA			BIT	IE.7
ICIE			BIT	IE.6
ERTCIE			BIT	IE.5
ES0			BIT	IE.4
ET1			BIT	IE.3
EX1			BIT	IE.2
ET0			BIT	IE.1
EX0			BIT	IE.0

PICIE      		BIT     IP.6
PRTCIE			BIT	IP.5
PS0			BIT     IP.4
PT1			BIT     IP.3
PX1			BIT     IP.2
PT0			BIT     IP.1
PX0			BIT     IP.0

SM00			BIT	SCON0.7
SM01			BIT	SCON0.6
MCE0			BIT	SCON0.5
REN0			BIT	SCON0.4
TB08			BIT	SCON0.3
RB08			BIT	SCON0.2
TI0			BIT     SCON0.1
RI0			BIT     SCON0.0

;------------------------------------------------------------------------------
; End Of File
;------------------------------------------------------------------------------